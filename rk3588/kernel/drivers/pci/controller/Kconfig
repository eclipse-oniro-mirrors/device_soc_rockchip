## rk3588/kernel/drivers/pci/controller/Kconfig
```kconfig
# SPDX-License-Identifier: GPL-2.0

menu "RK3588 PCI controller drivers"
	depends on PCI

config ROCKCHIP_PCIE_DMA_OBJ
	bool "Rockchip PCIe uDMA transfer support"
	depends on PCIE_ROCKCHIP_HOST || PCIE_DW_ROCKCHIP
	default n
	help
	  Say y to enable p2p DMA transfer between PCIe components.

source "vendor/drivers/pci/controller/dwc/Kconfig"

endmenu
```

## rk3588/kernel/drivers/phy/Kconfig
```kconfig
# SPDX-License-Identifier: GPL-2.0-only
#
# PHY
#

source "vendor/drivers/phy/rockchip/Kconfig"
```

## rk3588/kernel/drivers/pinctrl/Kconfig
```kconfig
# SPDX-License-Identifier: GPL-2.0-only
#
# PINCTRL infrastructure and drivers
#

if PINCTRL
config PINCTRL_RK806
	tristate "Pinctrl and GPIO driver for RK806 PMIC"
	depends on MFD_RK806
	select GPIOLIB
	select PINMUX
	select GENERIC_PINCONF
	help
	  This selects the pinctrl driver for RK806

endif
```

## rk3588/kernel/drivers/power/Kconfig
```kconfig
# SPDX-License-Identifier: GPL-2.0-only
source "vendor/drivers/power/supply/Kconfig"
```

## rk3588/kernel/drivers/power/supply/Kconfig
```kconfig
# SPDX-License-Identifier: GPL-2.0-only
menuconfig POWER_SUPPLY
	bool "Power supply class support"
	help
	  Say Y here to enable power supply class support. This allows
	  power supply (batteries, AC, USB) monitoring by userspace
	  via sysfs and uevent (if available) and/or APM kernel interface
	  (if selected below).

if POWER_SUPPLY

config CHARGER_BQ25700
	tristate "TI BQ25700 battery charger driver"
	depends on REGMAP_I2C
	help
	  Say Y to enable support for the TI BQ25700 battery charger.

config BATTERY_CW2017
	tristate "CW2017 Battery driver"
	depends on I2C
	select REGMAP_I2C
	help
	  Say Y here to enable support for the cellwise cw2017
	  battery fuel gauge (used in the Pinebook Pro & others)

	  This driver can also be built as a module. If so, the module will be
	  called cw2017_battery.
	  
config BATTERY_RK817
	tristate "RK817 Battery driver"
	depends on MFD_RK808
	help
	  If you say yes here you will get support for the battery of RK817 PMIC.
	  This driver can give support for Rk817 Battery Interface.

config CHARGER_RK817
	tristate "RK817 Charger driver"
	depends on MFD_RK808
	help
	  If you say yes here you will get support for the charger of RK817 PMIC.
	  This driver can give support for Rk817 Charger Interface.

endif # POWER_SUPPLY
```

## rk3588/kernel/drivers/regulator/Kconfig
```kconfig
# SPDX-License-Identifier: GPL-2.0-only
#
config REGULATOR_RK806
	tristate "Rockchip RK806 Power regulator"
	depends on MFD_RK806
	help
	  Select this option to enable the power regulator of ROCKCHIP
	  PMIC RK806. The device supports multiple DCDC/LDO
	  outputs which can be controlled by spi communication.
```

## rk3588/kernel/drivers/staging/Kconfig
```kconfig
# SPDX-License-Identifier: GPL-2.0
#
source "vendor/drivers/staging/android/Kconfig"
```

## rk3588/kernel/drivers/staging/android/Kconfig
```kconfig
# SPDX-License-Identifier: GPL-2.0
#
#
source "vendor/drivers/staging/android/fiq_debugger/Kconfig"
```

## rk3588/kernel/net/Kconfig
```kconfig
# SPDX-License-Identifier: GPL-2.0
#
# For a description of the syntax of this configuration file,
# see Documentation/kbuild/kconfig-language.rst.
#

source "vendor/net/rfkill/Kconfig"
```

## rk3588/kernel/net/rfkill/Kconfig
```kconfig
# SPDX-License-Identifier: GPL-2.0-only
#
# RF switch subsystem configuration
#
config RFKILL_RK
	tristate "Rockchip RFKILL driver"
	depends on RFKILL
	depends on MMC
	depends on ARCH_ROCKCHIP
	default y
	help
	  Rockchip rfkill driver for rk29/rk3X
```
