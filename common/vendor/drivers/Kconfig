## common/vendor/drivers/Kconfig
```kconfig
# SPDX-License-Identifier: GPL-2.0
config VENDOR_KHDVK_3566B_DRIVER_VIDEO
	bool "boars Device drivers video"
	default y
if VENDOR_KHDVK_3566B_DRIVER_VIDEO
source "vendor/drivers/video/Kconfig"
endif


config VENDOR_KHDVK_3566B_DRIVER_PHY
	bool "boars Device drivers phy"
	default y
if VENDOR_KHDVK_3566B_DRIVER_PHY
source "vendor/drivers/phy/Kconfig"
endif


config VENDOR_KHDVK_3566B_DRIVER_DMA_BUF
	bool "boars Device drivers dam buf"
	default y
if VENDOR_KHDVK_3566B_DRIVER_DMA_BUF
source "vendor/drivers/dma-buf/Kconfig"
endif

config VENDOR_KHDVK_3566B_DRIVER_MEDIA
	bool "boars Device drivers media"
	default y
if VENDOR_KHDVK_3566B_DRIVER_MEDIA
source "vendor/drivers/media/Kconfig"
endif

config VENDOR_KHDVK_3566B_DRIVER_WIRELESS
	bool "boars Device drivers wireless"
	default y


if VENDOR_KHDVK_3566B_DRIVER_WIRELESS
source "vendor/drivers/wireless/Kconfig"
endif

config VENDOR_KHDVK_3566B_DRIVER_GPIO
	bool "boars Device drivers gpio"
	default y

if VENDOR_KHDVK_3566B_DRIVER_GPIO
source "vendor/drivers/gpio/Kconfig"
endif


config VENDOR_KHDVK_3566B_DRIVER_NET
	bool "boars Device drivers net"
	default y

if VENDOR_KHDVK_3566B_DRIVER_NET
source "vendor/drivers/net/Kconfig"
endif

config VENDOR_KHDVK_3566B_DRIVER_FIRMWARE
	bool "VENDOR RK3566 FIRMWARE"
	default y
source "vendor/drivers/firmware/Kconfig"

#
# rk3566 driver configuration
#

config VENDOR_RK3566_DRIVER_MMC
	bool "rk3566 soc drivers mmc"
	default y
if VENDOR_RK3566_DRIVER_MMC
source "vendor/drivers/mmc/Kconfig"
endif

config VENDOR_RK3566_DRIVER_REGULATOR
	bool "rk3566 soc drivers regulator"
	default y
if VENDOR_RK3566_DRIVER_REGULATOR
source "vendor/drivers/regulator/Kconfig"
endif

config VENDOR_RK3566_DRIVER_PCI
	bool "rk3566 soc drivers pci"
	default y
if VENDOR_RK3566_DRIVER_PCI
source "vendor/drivers/pci/Kconfig"
endif

config VENDOR_RK3566_DRIVER_INPUT
	bool "rk3566 soc drivers input"
	default y
if VENDOR_RK3566_DRIVER_INPUT
source "vendor/drivers/input/Kconfig"
endif

config VENDOR_RK3566_DRIVER_STAGING
	bool "rk3566 soc drivers staging"
	default y
if VENDOR_RK3566_DRIVER_STAGING
source "vendor/drivers/staging/Kconfig"
endif

config VENDOR_RK3566_DRIVER_NET
	bool "rk3566 soc drivers net"
	default y
if VENDOR_RK3566_DRIVER_NET
source "vendor/drivers/net/Kconfig"
endif

config VENDOR_RK3566_DRIVER_DEVFREG
	bool "rk3566 soc drivers cpu dev freg"
	default y
if VENDOR_RK3566_DRIVER_DEVFREG
source "vendor/drivers/devfreq/Kconfig"
endif

config VENDOR_RK3566_DRIVER_CPUFINFO
	bool "rk3566 soc drivers cpu info"
	default y
if VENDOR_RK3566_DRIVER_CPUFINFO
source "vendor/drivers/rockchip/Kconfig"
endif

config VENDOR_RK3566_DRIVER_CPUFRQ
	bool "rk3566 soc drivers cpufreg"
	default y
if VENDOR_RK3566_DRIVER_CPUFRQ
source "vendor/drivers/cpufreq/Kconfig"
endif

config VENDOR_RK3566_DRIVER_CLK
	bool "rk3566 soc drivers clk"
	default y
if VENDOR_RK3566_DRIVER_CLK
source "vendor/drivers/clk/Kconfig"
endif

config VENDOR_RK3566_DRIVER_POWER
	bool "Vendor Power Drivers"
	default y

source "vendor/drivers/power/Kconfig"
```

## common/vendor/drivers/clk/Kconfig
```kconfig
# SPDX-License-Identifier: GPL-2.0
# common clock support for ROCKCHIP SoC family.

if VENDOR_RK3566_DRIVER_CLK

config CLK_RK1808
	tristate "Rockchip RK1808 clock controller support"
	depends on ARM64 || COMPILE_TEST
	default y
	help
	  Build the driver for RK1808 Clock Driver.

endif
```

## common/vendor/drivers/mmc/Kconfig
```kconfig
config VENDOR_RK3566_DRIVER_MMC_HOST
     bool "MMC HOST Drivers"
     default y

source "vendor/drivers/mmc/host/Kconfig"
```

## rk3588/kernel/Kconfig
```kconfig
# SPDX-License-Identifier: GPL-2.0
#
# For a description of the syntax of this configuration file,
# see Documentation/kbuild/kconfig-language.rst.
#

menu "RK3588 Chipset Code"
source "vendor/drivers/Kconfig"

source "vendor/net/Kconfig"
endmenu
```

## rk3588/kernel/drivers/Kconfig
```kconfig
# SPDX-License-Identifier: GPL-2.0
# Keep I/O buses first

source "vendor/drivers/clk/Kconfig"

source "vendor/drivers/firmware/Kconfig"

source "vendor/drivers/mmc/Kconfig"

source "vendor/drivers/phy/Kconfig"

source "vendor/drivers/devfreq/Kconfig"

source "vendor/drivers/gpio/Kconfig"

source "vendor/drivers/media/Kconfig"

source "vendor/drivers/pinctrl/Kconfig"

source "vendor/drivers/regulator/Kconfig"

source "vendor/drivers/staging/Kconfig"

source "vendor/drivers/cpufreq/Kconfig.arm"

source "vendor/drivers/dma-buf/Kconfig"

source "vendor/drivers/gpu/drm/rockchip/Kconfig"

source "vendor/drivers/input/Kconfig"

source "vendor/drivers/mfd/Kconfig"

source "vendor/drivers/net/Kconfig"

source "vendor/drivers/pci/Kconfig"

source "vendor/drivers/power/Kconfig"

source "vendor/drivers/soc/Kconfig"

source "vendor/drivers/video/Kconfig"
```

## rk3588/kernel/drivers/clk/Kconfig
```kconfig
# SPDX-License-Identifier: GPL-2.0

source "vendor/drivers/clk/rockchip/Kconfig"
```

## rk3588/kernel/drivers/clk/rockchip/Kconfig
```kconfig
# SPDX-License-Identifier: GPL-2.0
# common clock support for ROCKCHIP SoC family.

config CLK_RK3568
	tristate "Rockchip RK3568 clock controller support"
	depends on ARM64 || COMPILE_TEST
	default n
	help
	  Build the driver for RK3568 Clock Driver.

config CLK_RK3588
	tristate "Rockchip RK3588 clock controller support"
	depends on ARM64 || COMPILE_TEST
	default y
	help
	  Build the driver for RK3588 Clock Driver.

config CLK_RV1126
	tristate "Rockchip RV1126 clock controller support"
	depends on ARM || COMPILE_TEST
	default n
	help
	  Build the driver for RV1126 Clock Driver.

config CLK_RK1808
	tristate "Rockchip RK1808 clock controller support"
	depends on ARM64 || COMPILE_TEST
	default n
	help
	  Build the driver for RK1808 Clock Driver.

config ROCKCHIP_CLK_LINK
	tristate "Rockchip clock link support"
	default CLK_RK3588
	help
	  Say y here to enable clock link for Rockchip.
```

## rk3588/kernel/drivers/cpufreq/Kconfig.arm
```kconfig
# SPDX-License-Identifier: GPL-2.0-only
#
# ARM CPU Frequency scaling drivers
#

config ARM_ROCKCHIP_CPUFREQ
	tristate "Rockchip CPUfreq driver"
	depends on ARCH_ROCKCHIP && CPUFREQ_DT
	select PM_OPP
	help
	  This adds the CPUFreq driver support for Rockchip SoCs,
	  based on cpufreq-dt.

	  If in doubt, say N.
```

## rk3588/kernel/drivers/dma-buf/Kconfig
```kconfig
# SPDX-License-Identifier: GPL-2.0-only
#
source "vendor/drivers/dma-buf/heaps/Kconfig"
```

## rk3588/kernel/drivers/dma-buf/heaps/Kconfig
```kconfig
menuconfig DMABUF_HEAPS_DEFERRED_FREE
	bool "DMA-BUF heaps deferred-free library"
	help
	  Choose this option to enable the DMA-BUF heaps deferred-free library.

menuconfig DMABUF_HEAPS_PAGE_POOL
	bool "DMA-BUF heaps page-pool library"
	help
	  Choose this option to enable the DMA-BUF heaps page-pool library.
```

## rk3588/kernel/drivers/gpu/drm/rockchip/Kconfig
```kconfig
# SPDX-License-Identifier: GPL-2.0-only
config ROCKCHIP_DW_MIPI_DSI
	bool "Rockchip specific extensions for Synopsys DW MIPI DSI"
	select GENERIC_PHY_MIPI_DPHY
	help
	  This selects support for Rockchip SoC specific extensions
	  for the Synopsys DesignWare HDMI driver. If you want to
	  enable MIPI DSI on RK3288 or RK3399 based SoC, you should
	  select this option.

config ROCKCHIP_DW_DP
	bool "Rockchip specific extensions for Synopsys DW DPTX"
	help
	  Choose this option for Synopsys DesignWare Cores DisplayPort
	  transmit controller support on Rockchip SoC.

config ROCKCHIP_DRM_CUBIC_LUT
	bool "Support 3D cubic LUT"
	depends on NO_GKI
	help
	  This add properties to support provision of a 3D cubic
	  look up table, allowing for color specific adjustments.

config ROCKCHIP_DRM_DEBUG
	bool "Rockchip DRM debug"
	depends on DEBUG_FS
	help
	  This option add a debug node to dump buf from userspace
	  dump buffer store at: /data
	  debug node: /d/dri/0/ff900000.vop/vop_dump/dump
	  cat /d/dri/0/ff900000.vop/vop_dump/dump get more help
	  the upper ff900000.vop is different at different SOC platform.

config ROCKCHIP_VCONN
	bool "Rockchip Virtual connector driver for HDMI/DP/DSI"
	depends on DRM_ROCKCHIP
	help
	  This selects support virtual HDMI/DP/DSI drived by
	  rockchip vop, This is used for some test.
```

## rk3588/kernel/drivers/input/Kconfig
```kconfig
# SPDX-License-Identifier: GPL-2.0-only
#
# Input device configuration
#

source "vendor/drivers/input/remotectl/Kconfig"
```

## rk3588/kernel/drivers/media/Kconfig
```kconfig
# SPDX-License-Identifier: GPL-2.0-only
#
# Multimedia device configuration
#

source "vendor/drivers/media/i2c/Kconfig"
source "vendor/drivers/media/platform/Kconfig"
```

## rk3588/kernel/drivers/media/i2c/Kconfig
```kconfig
# SPDX-License-Identifier: GPL-2.0-only
#
# Multimedia Video device configuration
#

if VIDEO_V4L2

menu "RK3588 i2c Camear"
config VIDEO_OV13855
	tristate "OmniVision OV13855 sensor support"
	depends on I2C && VIDEO_V4L2 && VIDEO_V4L2_SUBDEV_API
	depends on MEDIA_CAMERA_SUPPORT
	select V4L2_FWNODE
	help
	  This is a Video4Linux2 sensor driver for the OmniVision
	  OV13855 camera.

config VIDEO_DW9763
        tristate "DW9763 lens voice coil support"
        depends on I2C && VIDEO_V4L2
        select MEDIA_CONTROLLER
        select VIDEO_V4L2_SUBDEV_API
        help
          This is a driver for the DW9763 camera lens voice coil.
          DW9763 is a 10 bit DAC with 120mA output current sink
          capability. This is designed for linear control of
          voice coil motors, controlled via I2C serial interface.

endmenu
endif # VIDEO_V4L2
```

## rk3588/kernel/drivers/media/platform/Kconfig
```kconfig
# SPDX-License-Identifier: GPL-2.0-only
#
# Multimedia device configuration
#

source "vendor/drivers/media/platform/rockchip/Kconfig"
```

## rk3588/kernel/drivers/media/platform/rockchip/Kconfig
```kconfig
# SPDX-License-Identifier: GPL-2.0-only
#
# Multimedia device configuration
#

source "vendor/drivers/media/platform/rockchip/isp/Kconfig"
source "vendor/drivers/media/platform/rockchip/ispp/Kconfig"
source "vendor/drivers/media/platform/rockchip/cif/Kconfig"
```

## rk3588/kernel/drivers/mfd/Kconfig
```kconfig
# SPDX-License-Identifier: GPL-2.0-only
#
# Multifunction miscellaneous devices
#

config MFD_RK806
	tristate "Rockchip RK806 Power Management Chip"
	select MFD_CORE
	select REGMAP
	select REGMAP_IRQ
	help
	  If you say yes here you get support for the RK806 Power Management chips.
	  This driver provides common support for accessing the device
	  through SPI interface. The device supports multiple sub-devices
	  including interrupts, LDO & DCDC regulators, and onkey.

config MFD_RK806_SPI
	tristate "RK806 Power Management chip with SPI"
	select MFD_RK806
	select REGMAP_SPI
	depends on SPI_MASTER
	help
	  If you say yes here you get support for the RK806 PM chips with SPI interface.
```

## rk3588/kernel/drivers/mmc/Kconfig
```kconfig
# SPDX-License-Identifier: GPL-2.0-only
#
# MMC subsystem configuration
#

source "vendor/drivers/mmc/host/Kconfig"
```

## rk3588/kernel/drivers/mmc/host/Kconfig
```kconfig
# SPDX-License-Identifier: GPL-2.0-only
#
# MMC/SD host controller drivers
#

config MMC_DW_ROCKCHIP
	tristate "Rockchip specific extensions for Synopsys DW Memory Card Interface"
	depends on MMC_DW && ARCH_ROCKCHIP
	select MMC_DW_PLTFM
	help
	  This selects support for Rockchip SoC specific extensions to the
	  Synopsys DesignWare Memory Card Interface driver. Select this option
	  for platforms based on RK3066, RK3188 and RK3288 SoC's.
```

## rk3588/kernel/drivers/net/Kconfig
```kconfig
# SPDX-License-Identifier: GPL-2.0-only
#
# Network device configuration
#

source "vendor/drivers/net/ethernet/Kconfig"
source "vendor/drivers/net/wireless/Kconfig"
```

## rk3588/kernel/drivers/net/ethernet/Kconfig
```kconfig
# SPDX-License-Identifier: GPL-2.0-only
#
# Ethernet LAN device configuration
#

source "vendor/drivers/net/ethernet/realtek/Kconfig"
source "vendor/drivers/net/ethernet/stmicro/Kconfig"
```

## rk3588/kernel/drivers/net/ethernet/realtek/Kconfig
```kconfig
# SPDX-License-Identifier: GPL-2.0-only
#
# Realtek device configuration
#

config NET_VENDOR_REALTEK
	bool "Realtek devices"
	default y
	depends on PCI || (PARPORT && X86)
	help
	  If you have a network (Ethernet) card belonging to this class, say Y.

	  Note that the answer to this question doesn't directly affect the
	  kernel: saying N will just cause the configurator to skip all
	  the questions about Realtek devices. If you say Y, you will be asked for
	  your specific card in the following questions.

if NET_VENDOR_REALTEK

config R8168
	tristate "Realtek 8168 gigabit ethernet support"
	depends on PCI
	select FW_LOADER
	select CRC32
	select PHYLIB
	select REALTEK_PHY
	help
	  Say Y here if you have a Realtek 8168 PCI Gigabit Ethernet adapter.

	  To compile this driver as a module, choose M here: the module
	  will be called r8168.  This is recommended.

endif # NET_VENDOR_REALTEK
```

## rk3588/kernel/drivers/net/ethernet/stmicro/stmmac/Kconfig
```kconfig
# SPDX-License-Identifier: GPL-2.0-only
config DWMAC_ROCKCHIP
	tristate "Rockchip dwmac support"
	default ARCH_ROCKCHIP
	depends on OF && (ARCH_ROCKCHIP || COMPILE_TEST)
	select MFD_SYSCON
	help
	  Support for Ethernet controller on Rockchip RK3288 SoC.

	  This selects the Rockchip RK3288 SoC glue layer support for
	  the stmmac device driver.
```

## rk3588/kernel/drivers/net/wireless/Kconfig
```kconfig
# SPDX-License-Identifier: GPL-2.0-only
#
# Wireless LAN device configuration
#
source "vendor/drivers/net/wireless/rockchip_wlan/Kconfig"
```

## rk3588/kernel/drivers/pci/Kconfig
```kconfig
# SPDX-License-Identifier: GPL-2.0
#
# PCI configuration
#

source "vendor/drivers/pci/controller/Kconfig"
```
